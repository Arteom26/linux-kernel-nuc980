## arch/arm/configs/nuc980_defconfig
```kconfig
# CPU Configuration
CONFIG_ARCH_NUC980=y
CONFIG_MACH_NUC980=y
CONFIG_BOARD_NUC980=y
CONFIG_NUC980_FIQ=y
CONFIG_ARCH_MULTI_V7=n
CONFIG_MAY_HAVE_SPARSE_IRQ=y
CONFIG_SPARSE_IRQ=n
CONFIG_ATAGS=y

# Serial Configuration
CONFIG_SERIAL_NUC980=y
CONFIG_SERIAL_NUC980_CONSOLE=y
CONFIG_DEBUG_KERNEL=y
CONFIG_DEBUG_LL=y
CONFIG_DEBUG_NUC980_UART=y
CONFIG_EARLY_PRINTK=y

# Device tree configuration
CONFIG_USE_OF=y
```

## drivers/crypto/nuvoton/Kconfig
```kconfig
config CRYPTO_DEV_NUC980
	tristate "Support for NUC980 Cryptographic Accelerator"
	depends on ARCH_NUC980
	select CRYPTO_CBC
	select CRYPTO_ECB
	select CRYPTO_AES
	select CRYPTO_ALGAPI
	select CRYPTO_BLKCIPHER
	select CRYPTO_SHA1
	select CRYPTO_SHA224
	select CRYPTO_SHA256
	select CRYPTO_SHA384
	select CRYPTO_SHA512
	help
	  To compile this driver as a module, choose M here: the module
	  will be called nuc980-crypto.
      
```

## drivers/net/ethernet/nuvoton/Kconfig
```kconfig
#
# Nuvoton network device configuration
#

config NET_VENDOR_NUVOTON
	bool "Nuvoton devices"
	default y
	depends on ARM && (ARCH_NUC980)
	help
	  If you have a network (Ethernet) card belonging to this class, say Y.

	  Note that the answer to this question doesn't directly affect the
	  kernel: saying N will just cause the configurator to skip all
	  the questions about Nuvoton cards. If you say Y, you will be asked
	  for your specific card in the following questions.

if NET_VENDOR_NUVOTON

config NUC980_ETH
        tristate "Nuvoton NUC980 Ethernet MAC 0 and MAC 1"
        depends on ARM && ARCH_NUC980
        select PHYLIB
        select NET_CORE
        select MII
        help
          Say Y here if you want to use built-in Ethernet MAC 0
          or MAC 1 on NUC980 MCU.

endif # NET_VENDOR_NUVOTON
```
